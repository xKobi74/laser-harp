#include "audio.h"
#include <stdio.h>
#include <stdlib.h>
#include <math.h>

#define MAX_OCTAVE_NUMBER 5
#define MIN_OCTAVE_NUMBER 1
//If you want to change this defines change some others in "stm32f1xx_it.c"
#define MAX_VOLUME 100
#define MIN_VOLUME 0
#define VOLUME_JUMP 10

const float pseudo_cos[256] = {1, 0.999849409, 0.999397728, 0.998645228, 0.997592363, 0.996239767, 0.994588255, 0.992638821, 0.99039264, 0.987851065, 0.985015627, 0.981888033, 0.978470168,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 0.999397728, 0.999849409};
const char number_of_notes = 7;

unsigned int freq_notes[7] = {260, 294, 330, 350, 392, 440, 494};

unsigned char octave_number = 1;
unsigned char volume = 100;

void change_octave(const unsigned char change_parameter) {
		if (change_parameter == CHANGE_PARAMETER_UP && octave_number < MAX_OCTAVE_NUMBER) {
			++octave_number;
			for (unsigned char i = 0; i < number_of_notes; i++) {
				freq_notes[i] <<= 1;
			}
		}
		else if (change_parameter == CHANGE_PARAMETER_DOWN && octave_number > MIN_OCTAVE_NUMBER) {
			--octave_number;
			for (unsigned char i = 0; i < number_of_notes; i++) {
				freq_notes[i] >>= 1;
			}
		}
}

void change_volume(const unsigned char change_parameter) {
		if (change_parameter == CHANGE_PARAMETER_UP && volume < MAX_VOLUME) {
			volume += VOLUME_JUMP;
		}
		else if (change_parameter == CHANGE_PARAMETER_DOWN && volume > MIN_VOLUME) {
			volume -= VOLUME_JUMP;
		}
}

sound* create_sound() {
    sound* N_A = (sound*)malloc(sizeof(sound));
    *N_A = (sound){{0.0f, 0.0f, 0.0f, 0.0f, 0.0f, 0.0f, 0.0f}, {0.0f, 0.0f, 0.0f, 0.0f, 0.0f, 0.0f, 0.0f}};
    return N_A;
}

void wait(sound* N_A, const float time, const float d_time) {
    float attenuation = powf(500.0f, d_time);
    for (int i = 0; i < number_of_notes; i++) {
        float* ptr_ampl = ((float*)(&(N_A->ampl)) + i);
        *ptr_ampl /= attenuation;

        float* ptr_in_time = ((float*)(&(N_A->in_time)) + i);
        *ptr_in_time = (*ptr_ampl) * pseudo_cos[(int)(256.0f * (float)freq_notes[i] * fmodf(time, 1.0f / (float)freq_notes[i]))];
    }
}

void signal(sound* N_A, unsigned char* signals) {
    for (int i = 0; i < number_of_notes; i++) {
        if (signals[i] != 0) {
            float *ptr_in_time = ((float*)(&(N_A->in_time)) + i);
            float *ptr_ampl = ((float*)(&(N_A->ampl)) + i);
            *ptr_in_time /= *ptr_ampl;
            if (*ptr_in_time > 1.0f) {*ptr_in_time = 1.0f;}
            *ptr_ampl = 1.0f;
        }
				signals[i] = 0;
    }
}

void delete_sound(sound* N_A) {
    free(N_A);
}

float summ_in_time(const sound* N_A) {
    float summ_ = 0.0f;
    for (int i = 0; i < number_of_notes; i++) {
        summ_ += *((float*)(&(N_A->in_time)) + i);
    }
    return (((float)volume/100.0f)*summ_)/(float)number_of_notes;
}

float summ_ampl(const sound* N_A) {
    float summ_ = 0.0f;
    for (int i = 0; i < number_of_notes; i++) {
        summ_ += *((float*)(&(N_A->ampl)) + i);
    }
    return summ_/(float)number_of_notes;
}